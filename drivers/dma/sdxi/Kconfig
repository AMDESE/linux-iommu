## drivers/dma/sdxi/Kconfig
```kconfig
config SDXI
	tristate "SDXI support"
	select DMA_ENGINE
	select DMA_VIRTUAL_CHANNELS
	select PACKING
	help
	  Enable support for Smart Data Accelerator Interface (SDXI)
	  Platform Data Mover devices. SDXI is a vendor-neutral
	  standard for a memory-to-memory data mover and acceleration
	  interface.

config SDXI_KUNIT_TEST
	tristate "SDXI unit tests" if !KUNIT_ALL_TESTS
	depends on SDXI && KUNIT
	default KUNIT_ALL_TESTS
	help
	  KUnit tests for parts of the SDXI driver. Does not require
	  SDXI hardware.

config SDXI_AMD_QOS
	tristate "AMD SDXI QoS vendor control"
	depends on SDXI
	default y
	help
	  Enable AMD SDXI Quality-of-Service vendor-command handling
	  through SDXI_ADMIN_VENDOR. This registers the AMD QoS GUID
	  with the SDXI core and lets the kernel compose the QoS
	  descriptors on the admin context on behalf of userspace.

	  If built as a module, this will be called sdxi-amd-qos.
```

## drivers/dma/tmpm/Kconfig
```kconfig
config AMD_TMPM
	tristate "AMD TMPM Page Migration DMA Engine"
	depends on X86_64 && ACPI
	default m
	help
	  Enable support for the AMD TMPM DMA engine.
	  The TMPM is to be used for page migration, not for
	  general purpose peripheral DMA.
```

## drivers/ksb/Kconfig
```kconfig
config KSB
	tristate "KSB test driver"
	default m
	select PCI_DOE
	select PCI_IDE
	help
	 Test driver.
```

## drivers/vfio/pci/sdxi/Kconfig
```kconfig
# SPDX-License-Identifier: GPL-2.0-only
config SDXI_VFIO_PCI
	tristate "VFIO support for SDXI PCI devices"
	depends on PCI && PCI_MSI
	depends on SDXI
	select VFIO_PCI_CORE
	help
	  VFIO driver for AMD SDXI (Smart Data Accelerator Interface)
	  PCI devices with savevm/loadvm migration support.

	  The driver saves and restores the small set of writable BAR0
	  control registers (CTL0, CTL2, CXT_L2, RKEY, ERR_CFG, ERR_CTL,
	  ERR_WRT, ERR_RD). Context tables, descriptor rings, and
	  completion-status blocks live in guest RAM and are captured
	  as part of the VM memory snapshot.

	  After resume, the variant driver asks the host SDXI PF driver
	  to restart the VF's contexts so the guest can resume DMA
	  without explicit cooperation.

	  P2P migration (VFIO_MIGRATION_P2P) enables QEMU live migration
	  when multiple SDXI VFs are assigned to one VM. SDXI cannot
	  quiesce peer DMA independently, so RUNNING_P2P uses the same
	  function stop (GSV_STOP) as STOP; see main.h for the FSM design.

	  PRE_COPY migration (VFIO_MIGRATION_PRE_COPY) keeps the function
	  active during the precopy phase; guest RAM dirtiness is tracked
	  via IOMMU dirty pages. The device migration stream carries the
	  MMIO blob only at STOP_COPY.

	  To compile this driver as a module, choose M here; the module
	  will be called sdxi-vfio-pci.
```
